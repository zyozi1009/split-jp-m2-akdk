## Kconfig
```kconfig
# 1. ZMK本体の巨大な設定メニューをすべて読み込む
source "Kconfig.zmk"

# 2. 自分の子供である、split_jp_m2シールドの固有メニューを読み込む
source "boards/shields/split_jp_m2/Kconfig.shield"
```

## boards/shields/split_jp_m2/Kconfig.defconfig
```kconfig
if SHIELD_SPLIT_JP_M2_LEFT

config ZMK_KEYBOARD_NAME
    default "split_jp_m2"

endif

if SHIELD_SPLIT_JP_M2_LEFT || SHIELD_SPLIT_JP_M2_RIGHT

config ZMK_SPLIT
    default y

endif
```

## boards/shields/split_jp_m2/Kconfig.shield
```kconfig
config SHIELD_SPLIT_JP_M2_LEFT
    def_bool $(shields_list_contains,split_jp_m2_left)
config SHIELD_SPLIT_JP_M2_RIGHT
    def_bool $(shields_list_contains,split_jp_m2_right)
```
